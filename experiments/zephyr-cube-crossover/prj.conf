## CMakeLists.txt
```
cmake_minimum_required(VERSION 3.20.0)

set(APP_BASE "${CMAKE_CURRENT_SOURCE_DIR}/../../apps/zephyr-hello-shell")
set(CUBE_BASE "${CMAKE_CURRENT_SOURCE_DIR}/../cube-hid-mouse")
set(KCONFIG_ROOT "${CMAKE_CURRENT_SOURCE_DIR}/Kconfig")
find_package(Zephyr REQUIRED HINTS $ENV{ZEPHYR_BASE})
project(zephyr_cube_crossover)

option(CROSSOVER_USE_ZEPHYR_BRIDGE "Use Zephyr's HCD bridge with Cube middleware" OFF)
option(CROSSOVER_USE_BOOT_MOUSE_CLASS "Use the application's boot-mouse class instead of Cube HID" OFF)
option(CROSSOVER_SLOW_CLASS_POLL "Sleep 1 ms between class-processing iterations" OFF)
option(CROSSOVER_BURST_CLASS_POLL "Use bounded 50 us class-processing bursts" OFF)

if(CROSSOVER_SLOW_CLASS_POLL AND CROSSOVER_BURST_CLASS_POLL)
  message(FATAL_ERROR "Choose only one crossover class polling cadence")
endif()

if(CROSSOVER_SLOW_CLASS_POLL)
  target_compile_definitions(app PRIVATE CROSSOVER_SLOW_CLASS_POLL)
endif()
if(CROSSOVER_BURST_CLASS_POLL)
  target_compile_definitions(app PRIVATE CROSSOVER_BURST_CLASS_POLL)
endif()

target_sources(app PRIVATE
  src/main.c
  ${APP_BASE}/src/boot_optimizations.c
  ${CUBE_BASE}/middleware/Core/Src/usbh_core.c
  ${CUBE_BASE}/middleware/Core/Src/usbh_ctlreq.c
  ${CUBE_BASE}/middleware/Core/Src/usbh_ioreq.c
  ${CUBE_BASE}/middleware/Core/Src/usbh_pipes.c
)

if(CROSSOVER_USE_BOOT_MOUSE_CLASS)
  target_sources(app PRIVATE
    ${APP_BASE}/src/usb_host/usb_boot_mouse_class.c
    ${APP_BASE}/src/usb_host/usb_boot_mouse_report.c
  )
  target_include_directories(app PRIVATE ${APP_BASE}/src/usb_host)
  target_compile_definitions(app PRIVATE CROSSOVER_BOOT_MOUSE_CLASS)
else()
  target_sources(app PRIVATE
    ${CUBE_BASE}/middleware/Class/HID/Src/usbh_hid.c
    ${CUBE_BASE}/middleware/Class/HID/Src/usbh_hid_mouse.c
    ${CUBE_BASE}/middleware/Class/HID/Src/usbh_hid_keybd.c
    ${CUBE_BASE}/middleware/Class/HID/Src/usbh_hid_parser.c
  )
endif()

if(CROSSOVER_USE_ZEPHYR_BRIDGE)
  target_sources(app PRIVATE
    ${APP_BASE}/src/usb_host/stm32_hcd_adapter.c
    ${APP_BASE}/src/usb_host/usb_gpio_capture.c
  )
  target_include_directories(app PRIVATE ${APP_BASE}/src/usb_host)
  target_compile_definitions(app PRIVATE CROSSOVER_ZEPHYR_BRIDGE)
else()
  target_sources(app PRIVATE ${CUBE_BASE}/src/usbh_platform.c)
  target_compile_definitions(app PRIVATE CUBE_ZEPHYR_CROSSOVER)
endif()
target_include_directories(app BEFORE PRIVATE
  include
  ${CUBE_BASE}/include
  ${CUBE_BASE}/middleware/Core/Inc
  ${CUBE_BASE}/middleware/Class/HID/Inc
)
```

## Kconfig
```
rsource "../../apps/zephyr-hello-shell/Kconfig"

config CUBE_CROSSOVER_GPIO
	bool
	default y
	select USE_STM32_HAL_GPIO
```

## prj.conf
```kconfig
CONFIG_MAIN_STACK_SIZE=3072
CONFIG_SERIAL=y
CONFIG_CONSOLE=y
CONFIG_UART_CONSOLE=y
CONFIG_SHELL=y
CONFIG_SHELL_BACKEND_SERIAL=y
CONFIG_SHELL_STACK_SIZE=2048
CONFIG_GPIO=y
CONFIG_PRINTK=y
CONFIG_BOOT_BANNER=n
CONFIG_EARLY_CONSOLE=y
CONFIG_SOC_PREP_HOOK=y
CONFIG_APP_USB_HOST_HCD=y
CONFIG_NETWORKING=n
CONFIG_HEAP_MEM_POOL_SIZE=4096
```

## src/main.c
```c
/* SPDX-License-Identifier: Apache-2.0 */
#include <zephyr/kernel.h>
#include <stdio.h>

#include "usbh_core.h"
#ifdef CROSSOVER_BOOT_MOUSE_CLASS
#include "usb_boot_mouse.h"
extern USBH_ClassTypeDef usb_boot_mouse_class;
#else
#include "usbh_hid.h"
#endif
#ifdef CROSSOVER_ZEPHYR_BRIDGE
#include "stm32_hcd_adapter.h"
#else
#include "app.h"
#endif

static USBH_HandleTypeDef host;
static volatile uint32_t report_count;
#ifndef CROSSOVER_ZEPHYR_BRIDGE
extern volatile uint32_t cube_mouse_first_irq;
#endif

static void user_event(USBH_HandleTypeDef *phost, uint8_t event)
{
	switch (event) {
	case HOST_USER_CONNECTION:
		printf("Cube crossover: connected\n");
		break;
	case HOST_USER_CLASS_ACTIVE:
		printf("Cube crossover: HID active VID=%04x PID=%04x\n",
		       phost->device.DevDesc.idVendor, phost->device.DevDesc.idProduct);
		break;
	case HOST_USER_DISCONNECTION:
		printf("Cube crossover: disconnected\n");
		break;
	case HOST_USER_UNRECOVERED_ERROR:
		printf("Cube crossover: unrecovered error\n");
		break;
	default:
		break;
	}
}

#ifndef CROSSOVER_BOOT_MOUSE_CLASS
void USBH_HID_EventCallback(USBH_HandleTypeDef *phost)
{
	HID_MOUSE_Info_TypeDef *mouse = USBH_HID_GetMouseInfo(phost);

	if (mouse != NULL) {
		report_count++;
		if (report_count <= 4U || mouse->x != 0U || mouse->y != 0U ||
		    mouse->buttons[0] || mouse->buttons[1] || mouse->buttons[2]) {
			printf("Cube crossover: report=%lu buttons=%u%u%u dx=%d dy=%d\n",
			       (unsigned long)report_count, mouse->buttons[0],
			       mouse->buttons[1], mouse->buttons[2],
			       (int)(int8_t)mouse->x, (int)(int8_t)mouse->y);
		}
	}
}
#endif

int main(void)
{
	printf("Cube middleware host under minimal Zephyr\n");
	if (USBH_Init(&host, user_event, 0U) != USBH_OK ||
#ifndef CROSSOVER_ZEPHYR_BRIDGE
	    hhcd_usb_fs.State != HAL_HCD_STATE_READY ||
#endif
	    USBH_RegisterClass(&host,
#ifdef CROSSOVER_BOOT_MOUSE_CLASS
			       &usb_boot_mouse_class
#else
			       USBH_HID_CLASS
#endif
			       ) != USBH_OK ||
	    USBH_Start(&host) != USBH_OK
#ifndef CROSSOVER_ZEPHYR_BRIDGE
	    ||
	    (USB_OTG_FS->GINTSTS & USB_OTG_GINTSTS_CMOD) == 0U) {
#else
	    ) {
#endif
		printf("Cube crossover: USB host initialization failed\n");
		return -1;
	}

	uint32_t last_status = k_uptime_get_32();
#ifdef CROSSOVER_BURST_CLASS_POLL
	uint8_t fast_poll_count = 0U;
#endif
#ifdef CROSSOVER_ZEPHYR_BRIDGE
	bool channels_printed = false;
#endif

	while (true) {
		(void)USBH_Process(&host);
		uint32_t now = k_uptime_get_32();

		if (now - last_status >= 2000U) {
#ifdef CROSSOVER_BOOT_MOUSE_CLASS
			struct usb_boot_mouse_report report;
			uint32_t count;

			if (usb_boot_mouse_last_report(&report, &count)) {
				report_count = count;
			}
#endif
#ifndef CROSSOVER_ZEPHYR_BRIDGE
			volatile uint32_t *hprt = (volatile uint32_t *)
				((uintptr_t)USB_OTG_FS + USB_OTG_HOST_PORT_BASE);

			printf("Cube crossover: state=%u reports=%lu first_irq=%08lx "
			       "connected=%u port=%u HPRT=%08lx GINTSTS=%08lx GINTMSK=%08lx "
			       "GAHBCFG=%08lx GPIOA=%08lx\n",
			       host.gState, (unsigned long)report_count,
			       (unsigned long)cube_mouse_first_irq,
			       host.device.is_connected, host.device.PortEnabled,
			       (unsigned long)*hprt, (unsigned long)USB_OTG_FS->GINTSTS,
			       (unsigned long)USB_OTG_FS->GINTMSK,
			       (unsigned long)USB_OTG_FS->GAHBCFG,
			       (unsigned long)GPIOA->MODER);
#else
			printf("Cube crossover (Zephyr bridge): state=%u reports=%lu connected=%u port=%u\n",
			       host.gState, (unsigned long)report_count,
			       host.device.is_connected, host.device.PortEnabled);
			if (!channels_printed && host.gState == HOST_CLASS) {
				stm32_hcd_adapter_debug_channels();
				channels_printed = true;
			}
#endif
			last_status = now;
		}
#ifdef CROSSOVER_BURST_CLASS_POLL
		if (++fast_poll_count < 100U) {
			k_busy_wait(50);
		} else {
			fast_poll_count = 0U;
			k_msleep(1);
		}
#elif defined(CROSSOVER_SLOW_CLASS_POLL)
		if (host.gState == HOST_CLASS) {
			k_msleep(1);
		} else {
			k_busy_wait(50);
		}
#else
		k_busy_wait(50);
#endif
	}
}
```

## include/usbh_conf.h
```c
#ifndef USBH_CONF_H
#define USBH_CONF_H

#include <stm32h7xx_hal.h>
#include <zephyr/kernel.h>
#include <stdio.h>
#include <string.h>

#define USBH_MAX_NUM_ENDPOINTS 2U
#define USBH_MAX_NUM_INTERFACES 2U
#define USBH_MAX_NUM_CONFIGURATION 1U
#define USBH_KEEP_CFG_DESCRIPTOR 1U
#define USBH_MAX_NUM_SUPPORTED_CLASS 1U
#define USBH_MAX_SIZE_CONFIGURATION 0x200U
#define USBH_MAX_DATA_BUFFER 0x200U
#define USBH_DEBUG_LEVEL 2U
#define USBH_USE_OS 0U
#define USBH_IN_NAK_PROCESS 0U

#define USBH_malloc k_malloc
#define USBH_free k_free
#define USBH_memset memset
#define USBH_memcpy memcpy

#define USBH_UsrLog(...) do { printf(__VA_ARGS__); printf("\r\n"); } while (0)
#define USBH_ErrLog(...) do { printf("ERROR: "); printf(__VA_ARGS__); printf("\r\n"); } while (0)
#define USBH_DbgLog(...) do { } while (0)

#endif
```
