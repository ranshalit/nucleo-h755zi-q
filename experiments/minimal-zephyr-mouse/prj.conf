## CMakeLists.txt
```
cmake_minimum_required(VERSION 3.20.0)

set(APP_BASE "${CMAKE_CURRENT_SOURCE_DIR}/../../apps/zephyr-hello-shell")
set(KCONFIG_ROOT "${APP_BASE}/Kconfig")
find_package(Zephyr REQUIRED HINTS $ENV{ZEPHYR_BASE})
project(minimal_zephyr_mouse)

target_sources(app PRIVATE
  src/main.c
  ${APP_BASE}/src/boot_optimizations.c
  ${APP_BASE}/src/board_io.c
  ${APP_BASE}/src/usb_host/stm32_hcd_adapter.c
  ${APP_BASE}/src/usb_host/usb_gpio_capture.c
  ${APP_BASE}/src/usb_host/usb_host_shell.c
  ${APP_BASE}/src/usb_host/usb_boot_mouse_report.c
  ${APP_BASE}/src/usb_host/usb_boot_mouse_class.c
  ${APP_BASE}/third_party/stm32-mw-usb-host/Core/Src/usbh_core.c
  ${APP_BASE}/third_party/stm32-mw-usb-host/Core/Src/usbh_ctlreq.c
  ${APP_BASE}/third_party/stm32-mw-usb-host/Core/Src/usbh_ioreq.c
  ${APP_BASE}/third_party/stm32-mw-usb-host/Core/Src/usbh_pipes.c
)

target_include_directories(app PRIVATE
  ${APP_BASE}/src/usb_host
  ${APP_BASE}/third_party/stm32-mw-usb-host/Core/Inc
)
```

## prj.conf
```kconfig
CONFIG_MAIN_STACK_SIZE=3072
CONFIG_SYSTEM_WORKQUEUE_STACK_SIZE=1024
CONFIG_SERIAL=y
CONFIG_CONSOLE=y
CONFIG_UART_CONSOLE=y
CONFIG_GPIO=y
CONFIG_SHELL=y
CONFIG_SHELL_BACKEND_SERIAL=y
CONFIG_SHELL_THREAD_PRIORITY_OVERRIDE=y
CONFIG_SHELL_THREAD_PRIORITY=9
CONFIG_SHELL_STACK_SIZE=3072
CONFIG_KERNEL_SHELL=y
CONFIG_BOOT_BANNER=n
CONFIG_EARLY_CONSOLE=y
CONFIG_PRINTK=y
CONFIG_SPEED_OPTIMIZATIONS=y
CONFIG_SOC_PREP_HOOK=y
CONFIG_APP_USB_HOST_HCD=y
CONFIG_NETWORKING=n
```

## boards/nucleo_h755zi_q_stm32h755xx_m7.overlay
```dts
&mac {
	status = "disabled";
};

&mdio {
	status = "disabled";
};

&gpiod {
	usb_vbus_disable {
		gpio-hog;
		gpios = <10 GPIO_ACTIVE_HIGH>;
		output-high;
		line-name = "USB VBUS disable (active-low enable)";
	};
};
```

## src/main.c
```c
/* SPDX-License-Identifier: Apache-2.0 */
#include <stdio.h>
#include <zephyr/kernel.h>

extern int board_usb_host_start(void);

int main(void)
{
	printf("Minimal Zephyr USB mouse host\n");
	int ret = board_usb_host_start();

	if (ret != 0) {
		printf("USB host startup failed: %d\n", ret);
	}
	return ret;
}
```
