## CMakeLists.txt
```
# SPDX-License-Identifier: Apache-2.0

cmake_minimum_required(VERSION 3.20.0)
find_package(Zephyr REQUIRED HINTS $ENV{ZEPHYR_BASE})
project(zephyr_msc_demo)

string(TIMESTAMP APP_BUILD_TIMESTAMP "%Y-%m-%dT%H:%M:%SZ" UTC)
target_compile_definitions(app PRIVATE
	APP_BUILD_TIMESTAMP=\"${APP_BUILD_TIMESTAMP}\"
)

target_sources(app PRIVATE
	src/main.c
	src/board_io.c
	src/http_server.c
	src/web_assets.c
	src/usb_msc.c
	src/sample_usbd_init.c
)
target_include_directories(app PRIVATE src)

zephyr_linker_sources(SECTIONS sections-rom.ld)
zephyr_linker_section(NAME http_resource_desc_board_http_service
                      KVMA RAM_REGION GROUP RODATA_REGION)
```

## prj.conf
```kconfig
CONFIG_MAIN_STACK_SIZE=3072
CONFIG_SYSTEM_WORKQUEUE_STACK_SIZE=1024

CONFIG_USB_DEVICE_STACK_NEXT=y

CONFIG_STDOUT_CONSOLE=y

CONFIG_USBD_MSC_CLASS=y
CONFIG_USBD_MSC_LUNS_PER_INSTANCE=1

CONFIG_DISK_DRIVER_RAM=y

CONFIG_FILE_SYSTEM=y
CONFIG_FILE_SYSTEM_MKFS=y
CONFIG_FAT_FILESYSTEM_ELM=y
CONFIG_FS_FATFS_LFN=y
CONFIG_FS_FATFS_MOUNT_MKFS=y

CONFIG_LOG=y
CONFIG_USBD_LOG_LEVEL_WRN=y
CONFIG_USBD_MSC_LOG_LEVEL_OFF=y
CONFIG_UDC_DRIVER_LOG_LEVEL_WRN=y

CONFIG_SAMPLE_USBD_PID=0x0009
CONFIG_SAMPLE_USBD_PRODUCT="STM32H7 Playground MSC Demo"

CONFIG_HWINFO=y

# UART shell console (from apps/zephyr-hello-shell)
CONFIG_SERIAL=y
CONFIG_CONSOLE=y
CONFIG_UART_CONSOLE=y
CONFIG_GPIO=y
CONFIG_SHELL=y
CONFIG_SHELL_BACKEND_SERIAL=y
CONFIG_KERNEL_SHELL=y
CONFIG_JSON_LIBRARY=y
CONFIG_SHELL_STACK_SIZE=3072

# Ethernet + HTTP server (from apps/zephyr-hello-shell)
CONFIG_NETWORKING=y
CONFIG_NET_L2_ETHERNET=y
CONFIG_NET_IPV4=y
CONFIG_NET_TCP=y
CONFIG_NET_ARP=y
CONFIG_NET_CONFIG_SETTINGS=y
CONFIG_NET_CONFIG_NEED_IPV4=y
CONFIG_NET_CONFIG_MY_IPV4_ADDR="192.168.55.2"
CONFIG_NET_CONFIG_MY_IPV4_NETMASK="255.255.255.0"
CONFIG_NET_CONFIG_PEER_IPV4_ADDR="192.168.55.100"
CONFIG_NET_TCP_TIME_WAIT_DELAY=0
CONFIG_NET_SHELL=y

CONFIG_HTTP_SERVER=y
CONFIG_HTTP_SERVER_NUM_SERVICES=1
CONFIG_HTTP_SERVER_STACK_SIZE=4096
CONFIG_HTTP_SERVER_MAX_CLIENTS=3
CONFIG_HTTP_SERVER_MAX_STREAMS=1
CONFIG_HTTP_SERVER_CLIENT_BUFFER_SIZE=256
CONFIG_HTTP_SERVER_CLIENT_INACTIVITY_TIMEOUT=1
CONFIG_HTTP_SERVER_MAX_URL_LENGTH=64
CONFIG_HTTP_SERVER_MAX_CONTENT_TYPE_LENGTH=64
```

## app.overlay
```dts
/*
 * Copyright (c) 2026 Ran Shalit
 * SPDX-License-Identifier: Apache-2.0
 *
 * In-RAM disk backing store for the USB mass storage demo, plus the
 * Ethernet PHY tweak needed by board_http_server_start().
 */

&eth_phy {
	no-reset;
};

/ {
	ramdisk0 {
		compatible = "zephyr,ram-disk";
		disk-name = "RAM";
		sector-size = <512>;
		sector-count = <256>;
	};
};
```

## src/main.c
```c
/*
 * SPDX-License-Identifier: Apache-2.0
 *
 * Combined demo: UART shell + LEDs + Ethernet HTTP server + USB Mass
 * Storage device. Adapted from apps/zephyr-hello-shell, replacing that
 * app's custom bare-metal USB host stack (still broken, see
 * docs/usb_debug.md) with the working USB MSC device-mode class.
 */

#include <errno.h>
#include <stdio.h>
#include <string.h>

#include <zephyr/shell/shell.h>

#include "board_io.h"
#include "http_server.h"
#include "usb_msc.h"

static int cmd_version(const struct shell *shell, size_t argc, char **argv)
{
	ARG_UNUSED(argc);
	ARG_UNUSED(argv);

	shell_print(shell, "zephyr-msc-demo");
	shell_print(shell, "Build time: %s", APP_BUILD_TIMESTAMP);
	return 0;
}

SHELL_CMD_REGISTER(version, NULL, "Show application build information", cmd_version);

static int print_led_state(const struct shell *shell, enum board_led_id led_id, const char *separator)
{
	const struct board_led_info *led = board_led_info_get(led_id);
	bool is_on;
	int ret;

	if (led == NULL) {
		shell_error(shell, "unknown LED index %d", led_id);
		return -EINVAL;
	}

	ret = board_led_get(led_id, &is_on);
	if (ret != 0) {
		shell_error(shell, "%s state read failed: %d", led->color, ret);
		return ret;
	}

	shell_print(shell, "%s%s%s", led->color, separator, is_on ? "on" : "off");
	return 0;
}

static int apply_led_action(const struct shell *shell, enum board_led_id led_id, const char *action)
{
	const struct board_led_info *led = board_led_info_get(led_id);
	bool is_on;
	int ret;

	if (led == NULL) {
		shell_error(shell, "unknown LED index %d", led_id);
		return -EINVAL;
	}

	ret = board_led_apply_action(led_id, action, &is_on);
	if (ret != 0) {
		shell_error(shell, "%s %s failed: %d", action, led->color, ret);
		return ret;
	}

	shell_print(shell, "%s -> %s", led->color, is_on ? "on" : "off");
	return 0;
}

static int with_selected_leds(const struct shell *shell, const char *selection,
			      int (*callback)(const struct shell *shell, enum board_led_id led_id,
					      const char *arg),
			      const char *arg)
{
	int ret;

	ret = board_io_init();
	if (ret != 0) {
		shell_error(shell, "board I/O initialization failed: %d", ret);
		return ret;
	}

	if (strcmp(selection, "all") == 0) {
		for (enum board_led_id led_id = BOARD_LED_GREEN; led_id < BOARD_LED_COUNT; ++led_id) {
			ret = callback(shell, led_id, arg);
			if (ret != 0) {
				return ret;
			}
		}

		return 0;
	}

	enum board_led_id led_id;

	ret = board_led_find(selection, &led_id);
	if (ret != 0) {
		shell_error(shell, "unknown LED color '%s'; use green, yellow, red, or all",
			    selection);
		return ret;
	}

	return callback(shell, led_id, arg);
}

static int cmd_led_action(const struct shell *shell, size_t argc, char **argv)
{
	ARG_UNUSED(argc);

	return with_selected_leds(shell, argv[1], apply_led_action, argv[0]);
}

static int cmd_led_status(const struct shell *shell, size_t argc, char **argv)
{
	const char *selection = (argc > 1) ? argv[1] : "all";

	return with_selected_leds(shell, selection, print_led_state, ": ");
}

SHELL_STATIC_SUBCMD_SET_CREATE(sub_leds,
	SHELL_CMD_ARG(on, NULL, "Turn user LEDs on: leds on <green|yellow|red|all>",
		      cmd_led_action, 2, 0),
	SHELL_CMD_ARG(off, NULL, "Turn user LEDs off: leds off <green|yellow|red|all>",
		      cmd_led_action, 2, 0),
	SHELL_CMD_ARG(toggle, NULL, "Toggle user LEDs: leds toggle <green|yellow|red|all>",
		      cmd_led_action, 2, 0),
	SHELL_CMD_ARG(status, NULL, "Show LED state: leds status [green|yellow|red|all]",
		      cmd_led_status, 1, 1),
	SHELL_SUBCMD_SET_END
);

SHELL_CMD_REGISTER(leds, &sub_leds, "Control the user LEDs (LD1/LD2/LD3)", NULL);

int main(void)
{
	int ret = board_io_init();

	printf("Hello World! %s\n", CONFIG_BOARD_TARGET);
	printf("Build time: %s\n", APP_BUILD_TIMESTAMP);

	if (ret != 0) {
		printf("Board I/O initialization failed: %d\n", ret);
		return ret;
	}

	ret = board_blink_threads_start();
	if (ret != 0) {
		printf("Blink thread startup failed: %d\n", ret);
		return ret;
	}

	printf("Blink threads started for yellow (%u ms) and red (%u ms)\n",
	       board_led_info_get(BOARD_LED_YELLOW)->blink_period_ms,
	       board_led_info_get(BOARD_LED_RED)->blink_period_ms);

	ret = board_http_server_start();
	if (ret != 0) {
		printf("HTTP server startup failed: %d\n", ret);
		return ret;
	}

	printf("HTTP server listening on http://%s:%u/\n",
	       CONFIG_NET_CONFIG_MY_IPV4_ADDR, board_http_server_port());

	ret = board_usb_msc_start();
	if (ret != 0) {
		printf("USB mass storage startup failed: %d\n", ret);
		/* Non-fatal: continue running LEDs/HTTP even if USB MSC init failed. */
	} else {
		printf("USB mass storage drive ready. Plug into a host.\n");
	}

	return 0;
}
```

## src/http_server.c
```c
/*
 * SPDX-License-Identifier: Apache-2.0
 */

#include "http_server.h"

#include <errno.h>
#include <stdarg.h>
#include <stdbool.h>
#include <stdio.h>
#include <string.h>

#include <zephyr/data/json.h>
#include <zephyr/kernel.h>
#include <zephyr/net/http/parser.h>
#include <zephyr/net/http/server.h>
#include <zephyr/net/http/service.h>
#include <zephyr/net/http/status.h>
#include <zephyr/net/net_if.h>
#include <zephyr/net/net_ip.h>
#include <zephyr/net/socket.h>
#include <zephyr/sys/util.h>

#include "board_io.h"
#include "web_assets.h"

#define BOARD_HTTP_PORT 80U
#define JSON_RESPONSE_BUF_SIZE 1024
#define LED_POST_BUF_SIZE 64

struct led_command {
	char led[16];
	char action[16];
};

static const struct json_obj_descr led_command_descr[] = {
	JSON_OBJ_DESCR_PRIM(struct led_command, led, JSON_TOK_STRING_BUF),
	JSON_OBJ_DESCR_PRIM(struct led_command, action, JSON_TOK_STRING_BUF),
};

static uint16_t board_http_port = BOARD_HTTP_PORT;
static bool http_server_started;

static const struct http_header close_connection_headers[] = {
	{
		.name = "Connection",
		.value = "close",
	},
};

struct static_asset {
	const uint8_t *data;
	const size_t *length;
};

static struct static_asset index_asset = {
	.data = board_http_index_html,
	.length = &board_http_index_html_len,
};

static struct static_asset styles_asset = {
	.data = board_http_styles_css,
	.length = &board_http_styles_css_len,
};

static struct static_asset app_js_asset = {
	.data = board_http_app_js,
	.length = &board_http_app_js_len,
};

static void prepare_close_response(struct http_client_ctx *client,
				   struct http_response_ctx *response_ctx)
{
	response_ctx->headers = close_connection_headers;
	response_ctx->header_count = ARRAY_SIZE(close_connection_headers);
	client->parser.flags |= F_CONNECTION_CLOSE;
}

HTTP_SERVICE_DEFINE(board_http_service, NULL, &board_http_port,
		    CONFIG_HTTP_SERVER_MAX_CLIENTS, CONFIG_HTTP_SERVER_MAX_CLIENTS, NULL, NULL);

static int static_asset_handler(struct http_client_ctx *client, enum http_data_status status,
				const struct http_request_ctx *request_ctx,
				struct http_response_ctx *response_ctx, void *user_data)
{
	struct static_asset *asset = user_data;

	ARG_UNUSED(client);
	ARG_UNUSED(request_ctx);

	if (status != HTTP_SERVER_DATA_FINAL) {
		return 0;
	}

	response_ctx->status = HTTP_200_OK;
	prepare_close_response(client, response_ctx);
	response_ctx->body = asset->data;
	response_ctx->body_len = *asset->length;
	response_ctx->final_chunk = true;

	return 0;
}

static struct http_resource_detail_dynamic index_resource_detail = {
	.common =
		{
			.type = HTTP_RESOURCE_TYPE_DYNAMIC,
			.bitmask_of_supported_http_methods = BIT(HTTP_GET),
			.content_type = "text/html",
		},
	.cb = static_asset_handler,
	.user_data = &index_asset,
};

static struct http_resource_detail_dynamic styles_resource_detail = {
	.common =
		{
			.type = HTTP_RESOURCE_TYPE_DYNAMIC,
			.bitmask_of_supported_http_methods = BIT(HTTP_GET),
			.content_type = "text/css",
		},
	.cb = static_asset_handler,
	.user_data = &styles_asset,
};

static struct http_resource_detail_dynamic app_js_resource_detail = {
	.common =
		{
			.type = HTTP_RESOURCE_TYPE_DYNAMIC,
			.bitmask_of_supported_http_methods = BIT(HTTP_GET),
			.content_type = "text/javascript",
		},
	.cb = static_asset_handler,
	.user_data = &app_js_asset,
};

static struct http_resource_detail_dynamic dashboard_styles_resource_detail = {
	.common =
		{
			.type = HTTP_RESOURCE_TYPE_DYNAMIC,
			.bitmask_of_supported_http_methods = BIT(HTTP_GET),
			.content_type = "text/css",
		},
	.cb = static_asset_handler,
	.user_data = &styles_asset,
};

static struct http_resource_detail_dynamic dashboard_js_resource_detail = {
	.common =
		{
			.type = HTTP_RESOURCE_TYPE_DYNAMIC,
			.bitmask_of_supported_http_methods = BIT(HTTP_GET),
			.content_type = "text/javascript",
		},
	.cb = static_asset_handler,
	.user_data = &app_js_asset,
};

static int append_to_buffer(char *buffer, size_t buffer_len, size_t *offset, const char *fmt, ...)
{
	int written;
	va_list args;

	if (*offset >= buffer_len) {
		return -ENOMEM;
	}

	va_start(args, fmt);
	written = vsnprintk(buffer + *offset, buffer_len - *offset, fmt, args);
	va_end(args);

	if (written < 0) {
		return written;
	}

	if ((size_t)written >= buffer_len - *offset) {
		*offset = buffer_len;
		return -ENOMEM;
	}

	*offset += (size_t)written;
	return 0;
}

static const char *json_bool(bool value)
{
	return value ? "true" : "false";
}

static const char *network_oper_state_str(enum net_if_oper_state state)
{
	switch (state) {
	case NET_IF_OPER_NOTPRESENT:
		return "not-present";
	case NET_IF_OPER_DOWN:
		return "down";
	case NET_IF_OPER_LOWERLAYERDOWN:
		return "lower-layer-down";
	case NET_IF_OPER_TESTING:
		return "testing";
	case NET_IF_OPER_DORMANT:
		return "dormant";
	case NET_IF_OPER_UP:
		return "up";
	case NET_IF_OPER_UNKNOWN:
	default:
		return "unknown";
	}
}

static void ipv4_to_string_or_default(const struct in_addr *addr, char *buffer, size_t buffer_len)
{
	if (addr == NULL || net_addr_ntop(AF_INET, addr, buffer, buffer_len) == NULL) {
		(void)snprintk(buffer, buffer_len, "unassigned");
	}
}

static int append_leds_json(char *buffer, size_t buffer_len, size_t *offset)
{
	int ret;

	ret = append_to_buffer(buffer, buffer_len, offset, "[");
	if (ret != 0) {
		return ret;
	}

	for (enum board_led_id led_id = BOARD_LED_GREEN; led_id < BOARD_LED_COUNT; ++led_id) {
		const struct board_led_info *led = board_led_info_get(led_id);
		bool is_on = false;

		if (led == NULL) {
			return -EINVAL;
		}

		ret = board_led_get(led_id, &is_on);
		if (ret != 0) {
			return ret;
		}

		ret = append_to_buffer(
			buffer, buffer_len, offset,
			"%s{\"color\":\"%s\",\"label\":\"%s\",\"state\":\"%s\",\"blinking\":%s,"
			"\"blink_period_ms\":%u}",
			(led_id == BOARD_LED_GREEN) ? "" : ",", led->color, led->label,
			is_on ? "on" : "off", json_bool(led->blinking), led->blink_period_ms);
		if (ret != 0) {
			return ret;
		}
	}

	return append_to_buffer(buffer, buffer_len, offset, "]");
}

static int build_io_json(char *buffer, size_t buffer_len)
{
	bool button_pressed;
	size_t offset = 0U;
	int ret;

	ret = board_button_get(&button_pressed);
	if (ret != 0) {
		return ret;
	}

	ret = append_to_buffer(buffer, buffer_len, &offset,
			       "{\"button\":{\"label\":\"%s\",\"pressed\":%s},\"leds\":",
			       board_button_label(), json_bool(button_pressed));
	if (ret != 0) {
		return ret;
	}

	ret = append_leds_json(buffer, buffer_len, &offset);
	if (ret != 0) {
		return ret;
	}

	ret = append_to_buffer(buffer, buffer_len, &offset, "}");
	if (ret != 0) {
		return ret;
	}

	return (int)offset;
}

static int build_status_json(char *buffer, size_t buffer_len)
{
	struct net_if *iface = net_if_get_default();
	char ipv4_addr[NET_IPV4_ADDR_LEN];
	char netmask[NET_IPV4_ADDR_LEN];
	char gateway[NET_IPV4_ADDR_LEN];
	static char __noinit io_json[JSON_RESPONSE_BUF_SIZE];
	struct in_addr *iface_addr = NULL;
	struct in_addr iface_netmask = { 0 };
	struct in_addr iface_gateway = { 0 };
	size_t offset = 0U;
	int ret;

	if (iface != NULL) {
		iface_addr = net_if_ipv4_get_global_addr(iface, NET_ADDR_PREFERRED);
		if (iface_addr != NULL) {
			iface_netmask = net_if_ipv4_get_netmask_by_addr(iface, iface_addr);
		}
		iface_gateway = net_if_ipv4_get_gw(iface);
	}

	ipv4_to_string_or_default(iface_addr, ipv4_addr, sizeof(ipv4_addr));
	ipv4_to_string_or_default(&iface_netmask, netmask, sizeof(netmask));
	ipv4_to_string_or_default(&iface_gateway, gateway, sizeof(gateway));

	ret = build_io_json(io_json, sizeof(io_json));
	if (ret < 0) {
		return ret;
	}

	ret = append_to_buffer(
		buffer, buffer_len, &offset,
		"{\"board\":\"%s\",\"uptime_ms\":%lld,\"http\":{\"port\":%u},\"network\":{"
		"\"ipv4\":\"%s\",\"netmask\":\"%s\",\"gateway\":\"%s\","
		"\"peer_ipv4\":\"%s\",\"admin_up\":%s,\"up\":%s,\"carrier\":%s,"
		"\"oper_state\":\"%s\"},\"io\":%s}",
		CONFIG_BOARD_TARGET, (long long)k_uptime_get(), board_http_port, ipv4_addr,
		netmask, gateway, CONFIG_NET_CONFIG_PEER_IPV4_ADDR,
		json_bool(net_if_is_admin_up(iface)), json_bool(net_if_is_up(iface)),
		json_bool(net_if_is_carrier_ok(iface)), network_oper_state_str(net_if_oper_state(iface)),
		io_json);
	if (ret != 0) {
		return ret;
	}

	return (int)offset;
}

static int build_led_action_json(char *buffer, size_t buffer_len, const char *selection,
				 const char *action)
{
	char io_json[JSON_RESPONSE_BUF_SIZE];
	int io_len;
	int ret;

	io_len = build_io_json(io_json, sizeof(io_json));
	if (io_len < 0) {
		return io_len;
	}

	ret = snprintk(buffer, buffer_len,
		       "{\"selection\":\"%s\",\"action\":\"%s\",\"io\":%s}",
		       selection, action, io_json);
	if (ret < 0) {
		return ret;
	}

	if ((size_t)ret >= buffer_len) {
		return -ENOMEM;
	}

	return ret;
}

static int build_dashboard_json(char *buffer, size_t buffer_len)
{
	static char __noinit status_json[JSON_RESPONSE_BUF_SIZE];
	static char __noinit io_json[JSON_RESPONSE_BUF_SIZE];
	int status_len;
	int io_len;
	int ret;

	status_len = build_status_json(status_json, sizeof(status_json));
	if (status_len < 0) {
		return status_len;
	}

	io_len = build_io_json(io_json, sizeof(io_json));
	if (io_len < 0) {
		return io_len;
	}

	ret = snprintk(buffer, buffer_len, "{\"status\":%s,\"io\":%s}", status_json, io_json);
	if (ret < 0) {
		return ret;
	}

	if ((size_t)ret >= buffer_len) {
		return -ENOMEM;
	}

	return ret;
}

static void populate_response(struct http_client_ctx *client, struct http_response_ctx *response_ctx,
			      enum http_status status, const uint8_t *body, size_t body_len)
{
	response_ctx->status = status;
	prepare_close_response(client, response_ctx);
	response_ctx->body = body;
	response_ctx->body_len = body_len;
	response_ctx->final_chunk = true;
}

static int send_internal_error(struct http_client_ctx *client, struct http_response_ctx *response_ctx,
			       char *buffer, size_t buffer_len)
{
	int ret = snprintk(buffer, buffer_len, "{\"error\":\"internal server error\"}");

	if (ret < 0) {
		return ret;
	}

	if ((size_t)ret >= buffer_len) {
		return -ENOMEM;
	}

	populate_response(client, response_ctx, HTTP_500_INTERNAL_SERVER_ERROR, buffer, (size_t)ret);
	return 0;
}

static int send_bad_request(struct http_client_ctx *client, struct http_response_ctx *response_ctx,
			    char *buffer, size_t buffer_len, const char *message)
{
	int ret = snprintk(buffer, buffer_len, "{\"error\":\"%s\"}", message);

	if (ret < 0) {
		return ret;
	}

	if ((size_t)ret >= buffer_len) {
		return -ENOMEM;
	}

	populate_response(client, response_ctx, HTTP_400_BAD_REQUEST, buffer, (size_t)ret);
	return 0;
}

static int status_handler(struct http_client_ctx *client, enum http_data_status status,
			  const struct http_request_ctx *request_ctx,
			  struct http_response_ctx *response_ctx, void *user_data)
{
	static char __noinit status_response[JSON_RESPONSE_BUF_SIZE];
	int ret;

	ARG_UNUSED(client);
	ARG_UNUSED(request_ctx);
	ARG_UNUSED(user_data);

	if (status != HTTP_SERVER_DATA_FINAL) {
		return 0;
	}

	ret = build_status_json(status_response, sizeof(status_response));
	if (ret < 0) {
		return send_internal_error(client, response_ctx, status_response,
					 sizeof(status_response));
	}

	populate_response(client, response_ctx, HTTP_200_OK, status_response, (size_t)ret);
	return 0;
}

static struct http_resource_detail_dynamic status_resource_detail = {
	.common =
		{
			.type = HTTP_RESOURCE_TYPE_DYNAMIC,
			.bitmask_of_supported_http_methods = BIT(HTTP_GET),
			.content_type = "application/json",
		},
	.cb = status_handler,
	.user_data = NULL,
};

static int io_handler(struct http_client_ctx *client, enum http_data_status status,
		      const struct http_request_ctx *request_ctx,
		      struct http_response_ctx *response_ctx, void *user_data)
{
	static char __noinit io_response[JSON_RESPONSE_BUF_SIZE];
	int ret;

	ARG_UNUSED(client);
	ARG_UNUSED(request_ctx);
	ARG_UNUSED(user_data);

	if (status != HTTP_SERVER_DATA_FINAL) {
		return 0;
	}

	ret = build_io_json(io_response, sizeof(io_response));
	if (ret < 0) {
		return send_internal_error(client, response_ctx, io_response, sizeof(io_response));
	}

	populate_response(client, response_ctx, HTTP_200_OK, io_response, (size_t)ret);
	return 0;
}

static struct http_resource_detail_dynamic io_resource_detail = {
	.common =
		{
			.type = HTTP_RESOURCE_TYPE_DYNAMIC,
			.bitmask_of_supported_http_methods = BIT(HTTP_GET),
			.content_type = "application/json",
		},
	.cb = io_handler,
	.user_data = NULL,
};

static int dashboard_handler(struct http_client_ctx *client, enum http_data_status status,
			     const struct http_request_ctx *request_ctx,
			     struct http_response_ctx *response_ctx, void *user_data)
{
	static char __noinit dashboard_response[JSON_RESPONSE_BUF_SIZE];
	int ret;

	ARG_UNUSED(client);
	ARG_UNUSED(request_ctx);
	ARG_UNUSED(user_data);

	if (status != HTTP_SERVER_DATA_FINAL) {
		return 0;
	}

	ret = build_dashboard_json(dashboard_response, sizeof(dashboard_response));
	if (ret < 0) {
		return send_internal_error(client, response_ctx, dashboard_response,
					   sizeof(dashboard_response));
	}

	populate_response(client, response_ctx, HTTP_200_OK, dashboard_response, (size_t)ret);
	return 0;
}

static struct http_resource_detail_dynamic dashboard_resource_detail = {
	.common =
		{
			.type = HTTP_RESOURCE_TYPE_DYNAMIC,
			.bitmask_of_supported_http_methods = BIT(HTTP_GET),
			.content_type = "application/json",
		},
	.cb = dashboard_handler,
	.user_data = NULL,
};

static int apply_led_action_to_selection(const char *selection, const char *action)
{
	int ret;

	if (strcmp(selection, "all") == 0) {
		for (enum board_led_id led_id = BOARD_LED_GREEN; led_id < BOARD_LED_COUNT; ++led_id) {
			ret = board_led_apply_action(led_id, action, NULL);
			if (ret != 0) {
				return ret;
			}
		}

		return 0;
	}

	enum board_led_id led_id;

	ret = board_led_find(selection, &led_id);
	if (ret != 0) {
		return ret;
	}

	return board_led_apply_action(led_id, action, NULL);
}

static int leds_handler(struct http_client_ctx *client, enum http_data_status status,
			const struct http_request_ctx *request_ctx,
			struct http_response_ctx *response_ctx, void *user_data)
{
	static char __noinit response_buffer[JSON_RESPONSE_BUF_SIZE];
	static uint8_t __noinit post_buffer[LED_POST_BUF_SIZE];
	static size_t cursor;
	struct led_command cmd = { 0 };
	const int expected_parse_mask = BIT_MASK(ARRAY_SIZE(led_command_descr));
	int ret;

	ARG_UNUSED(client);
	ARG_UNUSED(user_data);

	if (status == HTTP_SERVER_DATA_ABORTED) {
		cursor = 0U;
		return 0;
	}

	if (request_ctx->data_len + cursor > sizeof(post_buffer)) {
		cursor = 0U;
		return send_bad_request(client, response_ctx, response_buffer, sizeof(response_buffer),
					"request body too large");
	}

	memcpy(post_buffer + cursor, request_ctx->data, request_ctx->data_len);
	cursor += request_ctx->data_len;

	if (status != HTTP_SERVER_DATA_FINAL) {
		return 0;
	}

	ret = json_obj_parse(post_buffer, cursor, led_command_descr, ARRAY_SIZE(led_command_descr), &cmd);
	cursor = 0U;
	if (ret != expected_parse_mask) {
		return send_bad_request(client, response_ctx, response_buffer, sizeof(response_buffer),
					"expected JSON body with led and action fields");
	}

	ret = apply_led_action_to_selection(cmd.led, cmd.action);
	if (ret == -ENOENT) {
		return send_bad_request(client, response_ctx, response_buffer, sizeof(response_buffer),
					"unknown led selection");
	}

	if (ret == -EINVAL) {
		return send_bad_request(client, response_ctx, response_buffer, sizeof(response_buffer),
					"unknown action");
	}

	if (ret != 0) {
		return send_internal_error(client, response_ctx, response_buffer, sizeof(response_buffer));
	}

	ret = build_led_action_json(response_buffer, sizeof(response_buffer), cmd.led, cmd.action);
	if (ret < 0) {
		return send_internal_error(client, response_ctx, response_buffer, sizeof(response_buffer));
	}

	populate_response(client, response_ctx, HTTP_200_OK, response_buffer, (size_t)ret);
	return 0;
}

static struct http_resource_detail_dynamic leds_resource_detail = {
	.common =
		{
			.type = HTTP_RESOURCE_TYPE_DYNAMIC,
			.bitmask_of_supported_http_methods = BIT(HTTP_POST),
			.content_type = "application/json",
		},
	.cb = leds_handler,
	.user_data = NULL,
};

HTTP_RESOURCE_DEFINE(root_resource, board_http_service, "/", &index_resource_detail);
HTTP_RESOURCE_DEFINE(styles_resource, board_http_service, "/styles.css", &styles_resource_detail);
HTTP_RESOURCE_DEFINE(app_js_resource, board_http_service, "/app.js", &app_js_resource_detail);
HTTP_RESOURCE_DEFINE(dashboard_styles_resource, board_http_service, "/dashboard.css",
		     &dashboard_styles_resource_detail);
HTTP_RESOURCE_DEFINE(dashboard_js_resource, board_http_service, "/dashboard.js",
		     &dashboard_js_resource_detail);
HTTP_RESOURCE_DEFINE(dashboard_api_resource, board_http_service, "/api/v1/dashboard",
		     &dashboard_resource_detail);
HTTP_RESOURCE_DEFINE(status_resource, board_http_service, "/api/v1/status", &status_resource_detail);
HTTP_RESOURCE_DEFINE(io_resource, board_http_service, "/api/v1/io", &io_resource_detail);
HTTP_RESOURCE_DEFINE(leds_resource, board_http_service, "/api/v1/leds", &leds_resource_detail);

int board_http_server_start(void)
{
	int ret;

	if (http_server_started) {
		return 0;
	}

	ret = board_io_init();
	if (ret != 0) {
		return ret;
	}

	ret = http_server_start();
	if (ret == 0) {
		http_server_started = true;
	}

	return ret;
}

uint16_t board_http_server_port(void)
{
	return board_http_port;
}
```

## src/usb_msc.c
```c
/*
 * Copyright (c) 2026 Ran Shalit
 *
 * SPDX-License-Identifier: Apache-2.0
 *
 * USB Mass Storage backend for NUCLEO-H755ZI-Q, m7 core.
 *
 * Exposes a small in-RAM FAT-formatted disk as a USB flash drive over
 * the modern USBD stack (CONFIG_USB_DEVICE_STACK_NEXT + CONFIG_USBD_MSC_CLASS).
 * Bulk-only transport, no isochronous endpoints involved, so this avoids
 * the still-unresolved isoc/periodic-transfer stall documented for both
 * USB host mode and the UAC2 device-mode demo (see docs/usb_debug.md,
 * Steps 1-39 and Step 44).
 */

#include <sample_usbd.h>

#include "usb_msc.h"

#include <zephyr/kernel.h>
#include <zephyr/logging/log.h>
#include <zephyr/usb/usbd.h>
#include <zephyr/usb/class/usbd_msc.h>
#include <zephyr/fs/fs.h>
#include <ff.h>
#include <stdio.h>

LOG_MODULE_REGISTER(msc_demo, LOG_LEVEL_NONE);

USBD_DEFINE_MSC_LUN(ram, "RAM", "Zephyr", "RAMDisk", "0.00");

static struct usbd_context *msc_usbd;
static struct fs_mount_t fs_mnt;
static FATFS fat_fs;

static int enable_usb_device_next(void)
{
	int err;

	msc_usbd = sample_usbd_init_device(NULL);
	if (msc_usbd == NULL) {
		LOG_ERR("Failed to initialize USB device");
		return -ENODEV;
	}

	err = usbd_enable(msc_usbd);
	if (err) {
		LOG_ERR("Failed to enable device support");
		return err;
	}

	LOG_INF("USB device support enabled");

	return 0;
}

static void write_readme(void)
{
	struct fs_file_t file;
	static const char msg[] =
		"NUCLEO-H755ZI-Q USB Mass Storage demo\r\n"
		"Bulk-only USB MSC over Zephyr's modern USBD stack.\r\n"
		"Try editing/adding files -- they persist in board RAM\r\n"
		"until the next reset.\r\n";
	int rc;

	fs_file_t_init(&file);
	rc = fs_open(&file, "/RAM:/README.TXT", FS_O_CREATE | FS_O_WRITE);
	if (rc < 0) {
		LOG_ERR("Failed to create README.TXT: %d", rc);
		return;
	}

	fs_write(&file, msg, sizeof(msg) - 1);
	fs_close(&file);
}

static void setup_disk(void)
{
	struct fs_statvfs sbuf;
	int rc;

	fs_mnt.type = FS_FATFS;
	fs_mnt.fs_data = &fat_fs;
	fs_mnt.mnt_point = "/RAM:";

	rc = fs_mount(&fs_mnt);
	if (rc < 0) {
		LOG_ERR("Failed to mount RAM disk (%d), formatting", rc);
		rc = fs_mkfs(FS_FATFS, (uintptr_t)"RAM:", NULL, 0);
		if (rc < 0) {
			LOG_ERR("Failed to format RAM disk: %d", rc);
			return;
		}
		rc = fs_mount(&fs_mnt);
		if (rc < 0) {
			LOG_ERR("Failed to mount freshly-formatted disk: %d", rc);
			return;
		}
	}

	write_readme();

	/* Allow log messages to flush before printk output. */
	k_sleep(K_MSEC(50));

	rc = fs_statvfs(fs_mnt.mnt_point, &sbuf);
	if (rc == 0) {
		printk("%s: bsize=%lu frsize=%lu blocks=%lu bfree=%lu\n",
		       fs_mnt.mnt_point,
		       sbuf.f_bsize, sbuf.f_frsize,
		       sbuf.f_blocks, sbuf.f_bfree);
	}
}

int board_usb_msc_start(void)
{
	setup_disk();

	return enable_usb_device_next();
}
```

## src/usb_msc.h
```c
/*
 * Copyright (c) 2026 Ran Shalit
 * SPDX-License-Identifier: Apache-2.0
 */

#ifndef ZEPHYR_MSC_DEMO_USB_MSC_H_
#define ZEPHYR_MSC_DEMO_USB_MSC_H_

/* Mounts/formats the in-RAM disk and enables the USB MSC device class. */
int board_usb_msc_start(void);

#endif /* ZEPHYR_MSC_DEMO_USB_MSC_H_ */
```

## src/web_assets.h
```c
/*
 * SPDX-License-Identifier: Apache-2.0
 */

#ifndef ZEPHYR_HELLO_SHELL_WEB_ASSETS_H_
#define ZEPHYR_HELLO_SHELL_WEB_ASSETS_H_

#include <stddef.h>
#include <stdint.h>

extern const uint8_t board_http_index_html[];
extern const size_t board_http_index_html_len;

extern const uint8_t board_http_styles_css[];
extern const size_t board_http_styles_css_len;

extern const uint8_t board_http_app_js[];
extern const size_t board_http_app_js_len;

#endif /* ZEPHYR_HELLO_SHELL_WEB_ASSETS_H_ */
```
